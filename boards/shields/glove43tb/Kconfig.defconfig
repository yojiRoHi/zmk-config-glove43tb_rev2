## boards/shields/glove43tb/Kconfig.defconfig
```kconfig
if SHIELD_GLOVE43TB_R

config ZMK_KEYBOARD_NAME
    default "glove43tb_R"

config ZMK_SPLIT
    default y

config ZMK_SPLIT_ROLE_CENTRAL
    default y

endif

if SHIELD_GLOVE43TB_L

config ZMK_KEYBOARD_NAME
    default "glove43tb_L"

config ZMK_SPLIT
    default y

endif
```

## boards/shields/glove43tb/Kconfig.shield
```kconfig
config SHIELD_GLOVE43TB_R
    def_bool $(shields_list_contains,glove43tb_R)

config SHIELD_GLOVE43TB_L
    def_bool $(shields_list_contains,glove43tb_L)
```

## config/west.yml
```yaml
manifest:
  remotes:
    - name: zmkfirmware
      url-base: https://github.com/zmkfirmware
    - name: keebkuro
      url-base: https://github.com/keebkuro
    - name: caksoylar
      url-base: https://github.com/caksoylar
    - name: badjeff
      url-base: https://github.com/badjeff
  projects:
    - name: zmk
      remote: zmkfirmware
      revision: v0.3.0
      import: app/west.yml
    - name: zmk-pmw3610-driver
      remote: badjeff
      revision: zmk-0.3
    - name: zmk-rgbled-widget  # <-- new entry
      url: https://github.com/caksoylar/zmk-rgbled-widget
      revision: v0.3           # MUST match your ZMK version!
  self:
    path: config
    
```
